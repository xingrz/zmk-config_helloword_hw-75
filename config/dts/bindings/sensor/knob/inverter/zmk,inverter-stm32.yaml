## config/dts/bindings/sensor/knob/inverter/zmk,inverter-stm32.yaml
```yaml
# Copyright (c) 2022-2023 XiNGRZ
# SPDX-License-Identifier: MIT

description: STM32 TIM based output driver for generic 3-phase bridge driver

compatible: "zmk,inverter-stm32"

include: base.yaml

properties:
  enable-gpios:
    type: phandle-array

  pwm-period:
    type: int
    required: true
    description: PWM peroid in cycles

  pwm-channels:
    type: array
    required: true
    description: PWM channels for phase A, B and C
```

## config/dts/bindings/sensor/knob/profile/knob-profile.yaml
```yaml
# Copyright (c) 2023 XiNGRZ
# SPDX-License-Identifier: MIT

# Common fields for Knob profiles

properties:
  reg:
      type: array
      required: false

  torque-limit-mv:
    type: int

  velocity-pid:
    type: array

  angle-pid:
    type: array
```

## config/dts/bindings/sensor/knob/profile/zmk,knob-profile-damped.yaml
```yaml
# Copyright (c) 2023 XiNGRZ
# SPDX-License-Identifier: MIT

description: Knob damped profile

compatible: "zmk,knob-profile-damped"

include: knob-profile.yaml
```

## config/dts/bindings/sensor/knob/profile/zmk,knob-profile-disable.yaml
```yaml
# Copyright (c) 2023 XiNGRZ
# SPDX-License-Identifier: MIT

description: Knob disable profile

compatible: "zmk,knob-profile-disable"

include: knob-profile.yaml
```

## config/dts/bindings/sensor/knob/profile/zmk,knob-profile-encoder.yaml
```yaml
# Copyright (c) 2023 XiNGRZ
# SPDX-License-Identifier: MIT

description: Knob encoder profile

compatible: "zmk,knob-profile-encoder"

include: knob-profile.yaml
```

## config/dts/bindings/sensor/knob/profile/zmk,knob-profile-inertia.yaml
```yaml
# Copyright (c) 2023 XiNGRZ
# SPDX-License-Identifier: MIT

description: Knob inertia profile

compatible: "zmk,knob-profile-inertia"

include: knob-profile.yaml
```

## config/dts/bindings/sensor/knob/profile/zmk,knob-profile-ratchet.yaml
```yaml
# Copyright (c) 2023 XiNGRZ
# SPDX-License-Identifier: MIT

description: Knob ratchet profile

compatible: "zmk,knob-profile-ratchet"

include: knob-profile.yaml
```

## config/dts/bindings/sensor/knob/profile/zmk,knob-profile-spin.yaml
```yaml
# Copyright (c) 2023 XiNGRZ
# SPDX-License-Identifier: MIT

description: Knob spin profile

compatible: "zmk,knob-profile-spin"

include: knob-profile.yaml
```

## config/dts/bindings/sensor/knob/profile/zmk,knob-profile-spring.yaml
```yaml
# Copyright (c) 2023 XiNGRZ
# SPDX-License-Identifier: MIT

description: Knob spring profile

compatible: "zmk,knob-profile-spring"

include: knob-profile.yaml

properties:
  minimal-movement-deg:
    type: int
    required: false
    default: 20
```

## config/dts/bindings/sensor/knob/profile/zmk,knob-profile-switch.yaml
```yaml
# Copyright (c) 2023 XiNGRZ
# SPDX-License-Identifier: MIT

description: Knob switch profile

compatible: "zmk,knob-profile-switch"

include: knob-profile.yaml

properties:
  on-off-distance-deg:
    type: int
    required: false
    default: 80
```

## config/dts/bindings/sensor/knob/zmk,knob.yaml
```yaml
# Copyright (c) 2022-2023 XiNGRZ
# SPDX-License-Identifier: MIT

description: Sensor driver for FOC-emulated rotary encoder

compatible: "zmk,knob"

properties:
  label:
    type: string
  motor:
    type: phandle
    required: true
    description: The motor device

  tick-interval-us:
    type: int
    required: false
    default: 200
    description: Delay between each tick

  ppr:
    type: int
    required: false
    default: 24
    description: Number of pulses per full revolution
```

## config/dts/bindings/sensor/knob/zmk,motor.yaml
```yaml
# Copyright (c) 2022-2023 XiNGRZ
# SPDX-License-Identifier: MIT

description: Driver for FOC motor

compatible: "zmk,motor"

properties:
  inverter:
    type: phandle
    required: true
    description: The inverter device

  encoder:
    type: phandle
    required: true
    description: The encoder device

  pole-pairs:
    type: int
    required: false
    default: 7
```

## config/dts/bindings/zmk,keymap-ext.yaml
```yaml
compatible: "zmk,keymap-ext"

include: "zmk,keymap.yaml"

child-binding:
  properties:
    icon:
      type: uint8-array
      required: true
```

## config/dts/bindings/zmk,uart-slip.yaml
```yaml
# Copyright (c) 2022-2023 XiNGRZ
# SPDX-License-Identifier: MIT

description: |
  A transport layer built on top of UART

compatible: "zmk,uart-slip"

properties:
  uart:
    type: phandle
    required: true
```

## config/proto/Kconfig
```kconfig
# Copyright (c) 2022-2023 XiNGRZ
# SPDX-License-Identifier: MIT

config HW75_PROTO
	bool "Nanopb generated sources"

config HW75_PROTO_USB_COMM
	bool
	select HW75_PROTO

config HW75_PROTO_UART_COMM
	bool
	select HW75_PROTO
```

## config/west.yml
```yaml
manifest:
  projects:
    - name: zmk
      url: https://github.com/xingrz/zmk.git
      revision: zmkx-rel-20231018
      import: app/west.yml
  self:
    path: config
```
