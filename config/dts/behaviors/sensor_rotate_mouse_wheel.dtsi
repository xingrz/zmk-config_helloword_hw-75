/*
 * Copyright (c) 2022-2023 XiNGRZ
 * SPDX-License-Identifier: MIT
 */

#include "mouse_wheel.dtsi"

/ {
	behaviors {
		/omit-if-no-ref/ inc_dec_mw: behavior_sensor_rotate_mouse_wheel {
			compatible = "zmk,behavior-sensor-rotate-var";
			label = "ENC_MOUSE_WHEEL";
			#sensor-binding-cells = <2>;
			bindings = <&mw>, <&mw>;
		};
	};
};
