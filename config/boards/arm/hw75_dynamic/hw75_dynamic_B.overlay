/*
 * Copyright (c) 2023 XiNGRZ
 * SPDX-License-Identifier: MIT
 */

&ssd16xx {
	full {
		lut = [
			A0 90 50 00 00 00 00 00 00 00
			50 90 A0 00 00 00 00 00 00 00
			A0 90 50 00 00 00 00 00 00 00
			50 90 A0 00 00 00 00 00 00 00
			00 00 00 00 00 00 00 00 00 00
			0F 0F 00 00 00
			0F 0F 00 00 00
			0F 0F 00 00 00
			00 00 00 00 00
			00 00 00 00 00
			00 00 00 00 00
			00 00 00 00 00
			00 00 00 00 00
			00 00 00 00 00
			00 00 00 00 00
		];
	};

	partial {
		/* VGH = 19V */
		gdv = [15];

		/* VSH1 = 15V, VSH2 = 5V, VSL = -15V */
		sdv = [41 a8 32];

		/* VDB = LUT1 */
		border-waveform = <0x01>;

		/* 128x296, 50Hz */
		dummy-line = <0x30>;
		gate-line-width = <0x0a>;

		lut = [
			40 00 00 00 00 00 00 00 00 00
			80 00 00 00 00 00 00 00 00 00
			40 00 00 00 00 00 00 00 00 00
			80 00 00 00 00 00 00 00 00 00
			00 00 00 00 00 00 00 00 00 00
			1A 00 00 00 00
			00 00 00 00 00
			00 00 00 00 00
			00 00 00 00 00
			00 00 00 00 00
			00 00 00 00 00
			00 00 00 00 00
			00 00 00 00 00
			00 00 00 00 00
			00 00 00 00 00
		];
	};
};
