## config/boards/arm/hw75_keyboard/Kconfig.usb
```kconfig
# Copyright (c) 2022-2023 XiNGRZ
# SPDX-License-Identifier: MIT

config HW75_USB_COMM
	default y
	select HW75_USB_COMM_FEATURE_RGB

if HW75_USB_COMM

config HW75_USB_COMM_MAX_TX_MESSAGE_SIZE
	int
	default 64

config HW75_USB_COMM_MAX_RX_MESSAGE_SIZE
	int
	default 64

endif # HW75_USB_COMM
```

## config/boards/arm/hw75_keyboard/app/Kconfig
```kconfig
# Copyright (c) 2022-2023 XiNGRZ
# SPDX-License-Identifier: MIT

rsource "uart_comm/Kconfig"
```

## config/boards/arm/hw75_keyboard/app/uart_comm/Kconfig
```kconfig
# Copyright (c) 2022-2023 XiNGRZ
# SPDX-License-Identifier: MIT

DT_ALIAS_UART_COMM := uart-comm

config HW75_UART_COMM
	bool
	select SERIAL
	select HW75_PROTO_UART_COMM
	default $(dt_alias_enabled,$(DT_ALIAS_UART_COMM))

if HW75_UART_COMM

config HW75_UART_COMM_MAX_TX_MESSAGE_SIZE
	int
	default 64

module = HW75_UART_COMM
module-str = uart_comm
source "subsys/logging/Kconfig.template.log_config"

endif # HW75_UART_COMM
```

## config/boards/arm/hw75_keyboard/hw75_keyboard_defconfig
```kconfig
# Copyright (c) 2022-2023 XiNGRZ
# SPDX-License-Identifier: MIT

# SoC
CONFIG_SOC_SERIES_STM32F1X=y
CONFIG_SOC_STM32F103XB=y
CONFIG_CLOCK_CONTROL=y
CONFIG_PINCTRL=y

# RGB
CONFIG_ZMK_RGB_UNDERGLOW_EXT_POWER=n
CONFIG_ZMK_RGB_UNDERGLOW_AUTO_OFF_IDLE=y
CONFIG_ZMK_RGB_UNDERGLOW_BRT_MAX=15
CONFIG_HW75_INDICATOR_BRIGHTNESS_ACTIVE=255
CONFIG_HW75_INDICATOR_BRIGHTNESS_INACTIVE=10

# Storage
CONFIG_FLASH=y
CONFIG_FLASH_MAP=y
CONFIG_NVS=y
CONFIG_SETTINGS=y

# System
CONFIG_USE_DT_CODE_PARTITION=y
CONFIG_HEAP_MEM_POOL_SIZE=1024

# USB
CONFIG_USB_DEVICE_MANUFACTURER="HelloWord"
CONFIG_USB_DEVICE_PRODUCT="HW-75 Keyboard"
CONFIG_USB_HID_DEVICE_COUNT=2
```

## config/boards/arm/xikii_hw75/Kconfig.board
```kconfig
# HW-75 board configuration

# Copyright (c) 2022 The ZMK Contributors
# SPDX-License-Identifier: MIT

config BOARD_XIKII_HW75
	bool "Xikii HW-75"
	depends on SOC_STM32F103XB
```

## config/boards/arm/xikii_hw75/Kconfig.defconfig
```kconfig
# HW-75 board configuration

# Copyright (c) 2022 The ZMK Contributors
# SPDX-License-Identifier: MIT

if BOARD_XIKII_HW75

config BOARD
	default "xikii_hw75"

config ZMK_KEYBOARD_NAME
	default "Xikii HW-75"

config ZMK_USB
	default y

rsource "drivers/Kconfig"

endif # BOARD_XIKII_HW75
```

## config/boards/arm/xikii_hw75/xikii_hw75_defconfig
```kconfig
# Copyright (c) 2022 The ZMK Contributors
# SPDX-License-Identifier: MIT

# SoC
CONFIG_SOC_SERIES_STM32F1X=y
CONFIG_SOC_STM32F103XB=y
CONFIG_CLOCK_CONTROL=y
CONFIG_PINCTRL=y

# Buses
CONFIG_SPI=y
CONFIG_GPIO=y

# Logging
# CONFIG_LOG=y
# CONFIG_SERIAL=y
# CONFIG_CONSOLE=y
# CONFIG_UART_CONSOLE=y

# Key scanning
CONFIG_GPIO_STM32_SWJ_NOJTAG=y
CONFIG_ZMK_HID_REPORT_TYPE_NKRO=y

# RGB
CONFIG_LED_STRIP=y
CONFIG_WS2812_STRIP=y
CONFIG_WS2812_STRIP_SPI=y
CONFIG_ZMK_RGB_UNDERGLOW=y
CONFIG_ZMK_RGB_UNDERGLOW_EXT_POWER=n

# Storage
CONFIG_FLASH=y
CONFIG_FLASH_PAGE_LAYOUT=y
CONFIG_FLASH_MAP=y
CONFIG_NVS=y
CONFIG_SETTINGS=y
CONFIG_SETTINGS_NVS=y

# System
CONFIG_USE_DT_CODE_PARTITION=y

# USB
CONFIG_USB_DEVICE_MANUFACTURER="Xikii Industry"
CONFIG_USB_DEVICE_PRODUCT="Xikii HW-75"
```

## config/drivers/Kconfig
```kconfig
# Copyright (c) 2022-2023 XiNGRZ
# SPDX-License-Identifier: MIT

rsource "console/Kconfig"
rsource "display/Kconfig"
rsource "kscan/Kconfig"
rsource "led_strip/Kconfig"
rsource "sensor/Kconfig"
```

## config/drivers/console/Kconfig
```kconfig
# Copyright (c) 2022-2023 XiNGRZ
# SPDX-License-Identifier: MIT

rsource "Kconfig.uart_slip"
```

## config/drivers/console/Kconfig.uart_slip
```kconfig
# Copyright (c) 2022-2023 XiNGRZ
# SPDX-License-Identifier: MIT

DT_COMPAT_ZMK_UART_SLIP := zmk,uart-slip

config UART_SLIP
	bool "A transport layer built on top of UART"
	default $(dt_compat_enabled,$(DT_COMPAT_ZMK_UART_SLIP))
	depends on SERIAL
	select UART_INTERRUPT_DRIVEN
	select RING_BUFFER

if UART_SLIP

config UART_SLIP_INIT_PRIORITY
	int
	default 60

config UART_SLIP_RX_RING_BUFFER_SIZE
	int
	default 1024

module = UART_SLIP
module-str = uart_slip
source "subsys/logging/Kconfig.template.log_config"

endif # UART_SLIP
```

## config/drivers/display/Kconfig
```kconfig
# Copyright (c) 2022-2023 XiNGRZ
# SPDX-License-Identifier: MIT

rsource "Kconfig.ssd16xx"
rsource "Kconfig.sw_rotate"
```

## config/drivers/display/Kconfig.ssd16xx
```kconfig
# SSD16XX display controller configuration options

# Copyright (c) 2018 Phytec Messtechnik GmbH
# SPDX-License-Identifier: Apache-2.0

config HW75_SSD16XX
	bool "SSD16XX compatible display controller driver"
	default y
	depends on \
		DT_HAS_SOLOMON_SSD1608_ENABLED || \
		DT_HAS_SOLOMON_SSD1673_ENABLED || \
		DT_HAS_SOLOMON_SSD1675A_ENABLED || \
		DT_HAS_SOLOMON_SSD1680_ENABLED || \
		DT_HAS_SOLOMON_SSD1681_ENABLED
	select SPI
	select HW75_SSD16XX_NO_BLANK_ON_INIT
	help
	  Enable driver for SSD16XX compatible controller.

if HW75_SSD16XX

config HW75_SSD16XX_NO_BLANK_ON_INIT
	bool "Do not blank display on init"

endif # HW75_SSD16XX
```

## config/drivers/display/Kconfig.sw_rotate
```kconfig
# Copyright (c) 2022-2023 XiNGRZ
# SPDX-License-Identifier: MIT

DT_COMPAT_ZMK_DISPLAY_SW_ROTATE := zmk,display-sw-rotate

config DISPLAY_SW_ROTATE
	bool "A virtual display that rotates the frame by 90 degrees"
	default $(dt_compat_enabled,$(DT_COMPAT_ZMK_DISPLAY_SW_ROTATE))
	depends on DISPLAY

if DISPLAY_SW_ROTATE

endif # DISPLAY_SW_ROTATE
```

## config/drivers/led_strip/Kconfig.remap
```kconfig
# Copyright (c) 2022-2023 XiNGRZ
# SPDX-License-Identifier: MIT

DT_COMPAT_ZMK_LED_STRIP_REMAP := zmk,led-strip-remap

config LED_STRIP_REMAP
	bool "A virtual LED strip driver for reordering LEDs, with extended APIs to override status of individual LED"
	default $(dt_compat_enabled,$(DT_COMPAT_ZMK_LED_STRIP_REMAP))
	depends on LED_STRIP
```

## config/drivers/sensor/knob/Kconfig
```kconfig
# Copyright (c) 2022-2023 XiNGRZ
# SPDX-License-Identifier: MIT

config KNOB
	bool "Sensor driver for FOC-emulated rotary encoder"
	select SENSOR
	select CMSIS_DSP
	select CMSIS_DSP_FASTMATH

if KNOB

config KNOB_THREAD_PRIORITY
	int "Thread priority"
	default 10
	help
	  Priority of thread used by the driver to poll frames.

config KNOB_THREAD_STACK_SIZE
	int "Thread stack size"
	default 1024
	help
	  Stack size of thread used by the driver to poll frames.

config KNOB_MOTOR_INIT_PRIORITY
	int
	default 80

config KNOB_DRIVER_INIT_PRIORITY
	int
	default 70

rsource "inverter/Kconfig"
rsource "encoder/Kconfig"

endif # KNOB
```

## config/drivers/sensor/knob/encoder/Kconfig
```kconfig
# Copyright (c) 2022-2023 XiNGRZ
# SPDX-License-Identifier: MIT

rsource "Kconfig.as5047"
```

## config/drivers/sensor/knob/encoder/Kconfig.as5047
```kconfig
# Copyright (c) 2022-2023 XiNGRZ
# SPDX-License-Identifier: MIT

DT_COMPAT_AMS_AS5047 := ams,as5047

config KNOB_ENCODER_AS5047
	bool "14-bit on-axis magnetic rotary position sensor with 11-bit decimal and binary incremental pulse count"
	default $(dt_compat_enabled,$(DT_COMPAT_AMS_AS5047))
	select SPI
```

## config/drivers/sensor/knob/inverter/Kconfig.stm32
```kconfig
# Copyright (c) 2022-2023 XiNGRZ
# SPDX-License-Identifier: MIT

DT_COMPAT_ZMK_INVERTER_STM32 := zmk,inverter-stm32

config KNOB_INVERTER_STM32
	bool "STIM32 TIM based output driver for generic 3-phase bridge driver"
	default $(dt_compat_enabled,$(DT_COMPAT_ZMK_INVERTER_STM32))
	depends on SOC_FAMILY_STM32
	select PWM
	select USE_STM32_HAL_TIM
	select USE_STM32_HAL_TIM_EX
```

## config/dts/bindings/behaviors/zmk,behavior-lvgl-key-press.yaml
```yaml
# Copyright (c) 2022-2023 XiNGRZ
# SPDX-License-Identifier: MIT

description: Key press/release behavior bridging to LVGL

compatible: "zmk,behavior-lvgl-key-press"

include: one_param.yaml
```

## config/dts/bindings/behaviors/zmk,behavior-mouse-wheel.yaml
```yaml
# Copyright (c) 2022-2023 XiNGRZ
# SPDX-License-Identifier: MIT

description: Mouse wheel behavior

compatible: "zmk,behavior-mouse-wheel"

include: one_param.yaml
```

## config/dts/bindings/behaviors/zmk,behavior-sensor-rotate-mouse-wheel.yaml
```yaml
# Copyright (c) 2022-2023 XiNGRZ
# SPDX-License-Identifier: MIT

description: Sensor rotate mouse wheel behavior

compatible: "zmk,behavior-sensor-rotate-mouse-wheel"

properties:
  label:
    type: string
    required: true
  "#sensor-binding-cells":
    type: int
    required: true
    const: 2

sensor-binding-cells:
  - param1
  - param2
```

## config/dts/bindings/display/zmk,display-sw-rotate.yaml
```yaml
# Copyright (c) 2022-2023 XiNGRZ
# SPDX-License-Identifier: MIT

description: A virtual display that rotates the frame by 90 degrees.

compatible: "zmk,display-sw-rotate"

include: display-controller.yaml

properties:
  display:
    type: phandle
    required: true

  buffer-lines:
    type: int
    default: 32
```

## config/dts/bindings/drivers/kscan/zmk,kscan-gpio-74hc165.yaml
```yaml
# Copyright (c) 2022 The ZMK Contributors
# SPDX-License-Identifier: MIT

description: 74HC165 shift register keyboard KSCAN controller

compatible: "zmk,kscan-gpio-74hc165"

include: [kscan.yaml, spi-device.yaml]

properties:
  label:
    required: true

  chain-length:
    type: int
    required: true
    description: |
      The number of devices in the daisy-chain.

  scan-masks:
    type: uint8-array
    required: true
    description: |
      Bit mask of scanned bits for each daisy-chained device. Count of elements
      in this array should be same with chain-length.

  parallel-load-gpios:
    type: phandle-array
    required: true

  debounce-press-ms:
    type: int
    default: 5
    description: Debounce time for key press in milliseconds. Use 0 for eager debouncing.
  debounce-release-ms:
    type: int
    default: 5
    description: Debounce time for key release in milliseconds.
  debounce-scan-period-ms:
    type: int
    default: 1
    description: Time between reads in milliseconds when any key is pressed.
  poll-period-ms:
    type: int
    default: 10
    description: Time between reads in milliseconds when no key is pressed.
```

## config/dts/bindings/led_strip/zmk,led-strip-remap.yaml
```yaml
# Copyright (c) 2022-2023 XiNGRZ
# SPDX-License-Identifier: MIT

description: |
  A virtual LED strip driver for reordering LEDs, with additional APIs for using
  individual LEDs as custom indicators.

compatible: "zmk,led-strip-remap"

properties:
  label:
    type: string
    required: true
  chain-length:
    type: int
    required: true
    description: The number of LEDs in the strip.
  led-strip:
    type: phandle
    required: true
  map:
    type: array
    required: true
    description: The re-ordered index of LEDs.

child-binding:
  description: Subset of LEDs to be use as indicators.
  properties:
    label:
      type: string
      required: true
    led-indexes:
      type: array
      required: true
      description: The indexes of the LEDs in the subset.
```

## config/dts/bindings/sensor/knob/encoder/ams,as5047.yaml
```yaml
# Copyright (c) 2022-2023 XiNGRZ
# SPDX-License-Identifier: MIT

description: 14-bit on-axis magnetic rotary position sensor with 11-bit decimal and binary incremental pulse count

compatible: "ams,as5047"

include: spi-device.yaml

properties:
  cs-delay-us:
    type: int
    required: false
    default: 350
    description: Delay after pulling down and before releasing CS pin.

  init-delay-us:
    type: int
    required: false
    default: 0
    description: Delay before ready.
```
