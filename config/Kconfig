## config/Kconfig
```kconfig
# Copyright (c) 2022-2023 XiNGRZ
# SPDX-License-Identifier: MIT

rsource "app/Kconfig"
rsource "drivers/Kconfig"
rsource "proto/Kconfig"
```

## config/app/Kconfig
```kconfig
# Copyright (c) 2022-2023 XiNGRZ
# SPDX-License-Identifier: MIT

rsource "usb_comm/Kconfig"

rsource "Kconfig.hid_mouse"
rsource "Kconfig.indicator"
```

## config/app/Kconfig.hid_mouse
```kconfig
# Copyright (c) 2022-2023 XiNGRZ
# SPDX-License-Identifier: MIT

config HW75_HID_MOUSE
	bool "USB HID mouse simulation"
	depends on USB_DEVICE_HID

if HW75_HID_MOUSE

config HW75_HID_MOUSE_DEVICE_NAME
	string "Name of USB HID device to be used for mouse simulation"

endif # HW75_HID_MOUSE
```

## config/app/Kconfig.indicator
```kconfig
# Copyright (c) 2022-2023 XiNGRZ
# SPDX-License-Identifier: MIT

config HW75_INDICATOR
	bool "LED indicator"
	depends on LED_STRIP_REMAP
	default y if ZMK_RGB_UNDERGLOW

if HW75_INDICATOR

config HW75_INDICATOR_BRIGHTNESS_ACTIVE
	int "Brightness of indicator in active state"
	default 255

config HW75_INDICATOR_BRIGHTNESS_INACTIVE
	int "Brightness of indicator in inactive state"
	default 10

endif # HW75_INDICATOR
```

## config/app/usb_comm/Kconfig
```kconfig
# Copyright (c) 2022-2023 XiNGRZ
# SPDX-License-Identifier: MIT

config HW75_USB_COMM
	bool
	depends on USB_DEVICE_DRIVER
	select USB_DEVICE_BOS
	select HW75_PROTO_USB_COMM

if HW75_USB_COMM

config HW75_USB_COMM_MAX_TX_MESSAGE_SIZE
	int
	default 512

config HW75_USB_COMM_MAX_RX_MESSAGE_SIZE
	int
	default 512

config HW75_USB_COMM_MAX_BYTES_FIELD_SIZE
	int
	default 0

module = HW75_USB_COMM
module-str = usb_comm
source "subsys/logging/Kconfig.template.log_config"

config HW75_USB_COMM_FEATURE_RGB
	bool

config HW75_USB_COMM_FEATURE_EINK
	bool

config HW75_USB_COMM_FEATURE_KNOB
	bool

endif # HW75_USB_COMM
```

## config/boards/arm/hw75/Kconfig.board
```kconfig
# HW-75 board configuration

# Copyright (c) 2022 The ZMK Contributors
# SPDX-License-Identifier: MIT

config BOARD_HW75
	bool "HelloWord HW-75"
	depends on SOC_STM32F103XB
```

## config/boards/arm/hw75/Kconfig.defconfig
```kconfig
# HW-75 board configuration

# Copyright (c) 2022 The ZMK Contributors
# SPDX-License-Identifier: MIT

if BOARD_HW75

config BOARD
	default "hw75"

config ZMK_KEYBOARD_NAME
	default "HelloWord HW-75"

config ZMK_USB
	default y

choice ZMK_HID_REPORT_TYPE
	default ZMK_HID_REPORT_TYPE_NKRO
endchoice

config ZMK_RGB_UNDERGLOW
	default y
	select WS2812_STRIP
	select LED_STRIP
	select SPI

config ZMK_RGB_UNDERGLOW_EXT_POWER
	default n

rsource "drivers/Kconfig"

endif # BOARD_HW75
```

## config/boards/arm/hw75/drivers/Kconfig
```kconfig
# Copyright (c) 2022 The ZMK Contributors
# SPDX-License-Identifier: MIT

rsource "kscan/Kconfig"
rsource "led_strip/Kconfig"
```

## config/boards/arm/hw75/drivers/kscan/Kconfig
```kconfig
# Copyright (c) 2022 The ZMK Contributors
# SPDX-License-Identifier: MIT

DT_COMPAT_ZMK_KSCAN_GPIO_74HC165 := zmk,kscan-gpio-74hc165

config ZMK_KSCAN_GPIO_74HC165
	bool
	default $(dt_compat_enabled,$(DT_COMPAT_ZMK_KSCAN_GPIO_74HC165))
	select ZMK_KSCAN_GPIO_DRIVER
	select SPI
```

## config/boards/arm/hw75/hw75_defconfig
```kconfig
# Copyright (c) 2022 The ZMK Contributors
# SPDX-License-Identifier: MIT

# SoC
CONFIG_SOC_SERIES_STM32F1X=y
CONFIG_SOC_STM32F103XB=y
CONFIG_CLOCK_CONTROL=y
CONFIG_PINCTRL=y

# Buses
CONFIG_SPI=y
CONFIG_GPIO=y

# Key scanning
CONFIG_GPIO_STM32_SWJ_NOJTAG=y
CONFIG_ZMK_HID_REPORT_TYPE_NKRO=y

# RGB
CONFIG_LED_STRIP=y
CONFIG_WS2812_STRIP=y
CONFIG_WS2812_STRIP_SPI=y
CONFIG_ZMK_RGB_UNDERGLOW=y
CONFIG_ZMK_RGB_UNDERGLOW_EXT_POWER=n

# Storage
CONFIG_FLASH=y
CONFIG_FLASH_PAGE_LAYOUT=y
CONFIG_FLASH_MAP=y
CONFIG_NVS=y
CONFIG_SETTINGS=y
CONFIG_SETTINGS_NVS=y

# System
CONFIG_USE_DT_CODE_PARTITION=y

# USB
CONFIG_USB_DEVICE_MANUFACTURER="HelloWord"
CONFIG_USB_DEVICE_PRODUCT="HW-75"
```

## config/boards/arm/hw75_dynamic/Kconfig.board
```kconfig
# HW-75 board configuration

# Copyright (c) 2022 The ZMK Contributors
# SPDX-License-Identifier: MIT

config BOARD_HW75_DYNAMIC
	bool "HelloWord HW-75 Dynamic"
	depends on SOC_STM32F405XG
```

## config/boards/arm/hw75_dynamic/Kconfig.defconfig
```kconfig
# HW-75 board configuration

# Copyright (c) 2022 The ZMK Contributors
# SPDX-License-Identifier: MIT

if BOARD_HW75_DYNAMIC

config BOARD
	default "hw75_dynamic"

config ZMK_KEYBOARD_NAME
	default "HelloWord HW-75 Dynamic"

config ZMK_USB
	default y

rsource "Kconfig.display"
rsource "Kconfig.rgb"
rsource "Kconfig.rtt"
rsource "Kconfig.uf2"
rsource "Kconfig.usb"

rsource "app/Kconfig"

endif # BOARD_HW75_DYNAMIC
```

## config/boards/arm/hw75_dynamic/Kconfig.display
```kconfig
# Copyright (c) 2022 The ZMK Contributors
# SPDX-License-Identifier: MIT

config ZMK_DISPLAY
	select SSD1306
	select I2C

if ZMK_DISPLAY

choice ZMK_DISPLAY_WORK_QUEUE
	default ZMK_DISPLAY_WORK_QUEUE_DEDICATED
endchoice

config LV_Z_VDB_SIZE
	default 100

config LV_Z_BITS_PER_PIXEL
	default 1

choice LV_COLOR_DEPTH
	default LV_COLOR_DEPTH_16
endchoice

endif # ZMK_DISPLAY

if SSD1306

choice SSD1306_CONTROLLER_TYPE
	default SSD1306_SH1106_COMPATIBLE
endchoice

config SSD1306_REVERSE_MODE
	default y

endif # SSD1306
```

## config/boards/arm/hw75_dynamic/Kconfig.rgb
```kconfig
# Copyright (c) 2022-2023 XiNGRZ
# SPDX-License-Identifier: MIT

config ZMK_RGB_UNDERGLOW
	default y
	select WS2812_STRIP
	select LED_STRIP
	select SPI
```

## config/boards/arm/hw75_dynamic/Kconfig.uf2
```kconfig
# Copyright (c) 2022-2023 XiNGRZ
# SPDX-License-Identifier: MIT

config BUILD_OUTPUT_UF2
	default y

if BUILD_OUTPUT_UF2

config BUILD_OUTPUT_UF2_FAMILY_ID
	default "0x57755a57"

config BUILD_OUTPUT_UF2_USE_FLASH_BASE
	default y

config BUILD_OUTPUT_UF2_USE_FLASH_OFFSET
	default y

endif # BUILD_OUTPUT_UF2
```

## config/boards/arm/hw75_dynamic/Kconfig.usb
```kconfig
# Copyright (c) 2022-2023 XiNGRZ
# SPDX-License-Identifier: MIT

config HW75_USB_COMM
	default y
	select HW75_USB_COMM_FEATURE_RGB
	select HW75_USB_COMM_FEATURE_EINK
	select HW75_USB_COMM_FEATURE_KNOB

if HW75_USB_COMM

config HW75_USB_COMM_MAX_TX_MESSAGE_SIZE
	int
	default 4096

config HW75_USB_COMM_MAX_RX_MESSAGE_SIZE
	int
	default 8192

config HW75_USB_COMM_MAX_BYTES_FIELD_SIZE
	int
	default 8192

endif # HW75_USB_COMM
```

## config/boards/arm/hw75_dynamic/app/Kconfig
```kconfig
# Copyright (c) 2022-2023 XiNGRZ
# SPDX-License-Identifier: MIT

rsource "screen/Kconfig"
rsource "uart_comm/Kconfig"

rsource "Kconfig.eink"
rsource "Kconfig.knob"
```

## config/boards/arm/hw75_dynamic/app/Kconfig.eink
```kconfig
# Copyright (c) 2023 XiNGRZ
# SPDX-License-Identifier: MIT

DT_ALIAS_EINK := eink

config HW75_EINK
	bool
	default $(dt_alias_enabled,$(DT_ALIAS_EINK))
```

## config/boards/arm/hw75_dynamic/app/screen/Kconfig
```kconfig
# Copyright (c) 2022-2023 XiNGRZ
# SPDX-License-Identifier: MIT

config ZMK_DISPLAY_STATUS_SCREEN_CUSTOM
	select LV_USE_LABEL
	select LV_USE_BTN
	select LV_USE_LIST
	select LV_USE_FLEX
	select LV_USE_PAGE
	select LV_USE_GROUP
	select LV_USE_ANIMATION
```

## config/boards/arm/hw75_dynamic/app/uart_comm/Kconfig
```kconfig
# Copyright (c) 2022-2023 XiNGRZ
# SPDX-License-Identifier: MIT

config HW75_UART_COMM
	bool
	select SERIAL
	select CONSOLE
	select UART_PIPE
	select HW75_PROTO_UART_COMM
	default y

if HW75_UART_COMM

config HW75_UART_COMM_THREAD_PRIORITY
	int
	default 10

config HW75_UART_COMM_THREAD_STACK_SIZE
	int
	default 1024

config HW75_UART_COMM_MAX_RX_MESSAGE_SIZE
	int
	default 64

module = HW75_UART_COMM
module-str = uart_comm
source "subsys/logging/Kconfig.template.log_config"

endif # HW75_UART_COMM
```

## config/boards/arm/hw75_dynamic/app/usb_comm/Kconfig
```kconfig
# Copyright (c) 2022-2023 XiNGRZ
# SPDX-License-Identifier: MIT

config HW75_USB_COMM
	bool
	depends on USB_DEVICE_DRIVER
	select USB_DEVICE_BOS
	select HW75_PROTO_USB_COMM
	default y

if HW75_USB_COMM

config HW75_USB_COMM_MAX_TX_MESSAGE_SIZE
	int
	default 4096

config HW75_USB_COMM_MAX_RX_MESSAGE_SIZE
	int
	default 8192

config HW75_USB_COMM_MAX_BYTES_FIELD_SIZE
	int
	default 8192

module = HW75_USB_COMM
module-str = usb_comm
source "subsys/logging/Kconfig.template.log_config"

endif # HW75_USB_COMM
```

## config/boards/arm/hw75_dynamic/hw75_dynamic_defconfig
```kconfig
# Copyright (c) 2022 The ZMK Contributors
# SPDX-License-Identifier: MIT

# SoC
CONFIG_SOC_SERIES_STM32F4X=y
CONFIG_SOC_STM32F405XG=y
CONFIG_ARM_MPU=y
CONFIG_HW_STACK_PROTECTION=y
CONFIG_CLOCK_CONTROL=y
CONFIG_PINCTRL=y

# Key scanning　
CONFIG_ZMK_KSCAN_DIRECT_POLLING=y

# Display
CONFIG_ZMK_DISPLAY=y
CONFIG_ZMK_DISPLAY_STATUS_SCREEN_CUSTOM=y
CONFIG_ZMK_WIDGET_LAYER_STATUS=n
CONFIG_ZMK_WIDGET_BATTERY_STATUS=n
CONFIG_ZMK_WIDGET_OUTPUT_STATUS=n
CONFIG_ZMK_WIDGET_PERIPHERAL_STATUS=n
CONFIG_ZMK_WIDGET_WPM_STATUS=n
CONFIG_LV_USE_THEME_MONO=n
CONFIG_LV_USE_THEME_BASIC=y

# E-Ink
CONFIG_SSD16XX=n
CONFIG_HW75_SSD16XX=y

# RGB
CONFIG_ZMK_RGB_UNDERGLOW_EFF_START=2
CONFIG_ZMK_RGB_UNDERGLOW_EXT_POWER=n
CONFIG_ZMK_RGB_UNDERGLOW_AUTO_OFF_IDLE=y
CONFIG_HW75_INDICATOR_BRIGHTNESS_ACTIVE=5
CONFIG_HW75_INDICATOR_BRIGHTNESS_INACTIVE=1

# Sensor
CONFIG_KNOB=y

# Storage
CONFIG_FLASH=y
CONFIG_FLASH_MAP=y
CONFIG_NVS=y
CONFIG_SETTINGS=y

# System
CONFIG_USE_DT_CODE_PARTITION=y
CONFIG_NEWLIB_LIBC=y
CONFIG_CBPRINTF_COMPLETE=y
CONFIG_CBPRINTF_FP_SUPPORT=y
CONFIG_SYSTEM_WORKQUEUE_STACK_SIZE=2048

# USB
CONFIG_USB_DEVICE_MANUFACTURER="HelloWord"
CONFIG_USB_DEVICE_PRODUCT="HW-75 Dynamic"
CONFIG_USB_HID_DEVICE_COUNT=3
CONFIG_HW75_HID_MOUSE=y
CONFIG_HW75_HID_MOUSE_DEVICE_NAME="HID_2"
```

## config/boards/arm/hw75_keyboard/Kconfig.board
```kconfig
# HW-75 board configuration

# Copyright (c) 2022-2023 XiNGRZ
# SPDX-License-Identifier: MIT

config BOARD_HW75_KEYBOARD
	bool "HelloWord HW-75 Keyboard"
	depends on SOC_STM32F103XB
```

## config/boards/arm/hw75_keyboard/Kconfig.defconfig
```kconfig
# HW-75 board configuration

# Copyright (c) 2022-2023 XiNGRZ
# SPDX-License-Identifier: MIT

if BOARD_HW75_KEYBOARD

config BOARD
	default "hw75_keyboard"

config ZMK_KEYBOARD_NAME
	default "HelloWord HW-75 Keyboard"

config ZMK_USB
	default y

choice ZMK_HID_REPORT_TYPE
	default ZMK_HID_REPORT_TYPE_NKRO
endchoice

rsource "Kconfig.rgb"
rsource "Kconfig.rtt"
rsource "Kconfig.uf2"
rsource "Kconfig.usb"

rsource "app/Kconfig"

endif # BOARD_HW75_KEYBOARD
```

## config/boards/arm/hw75_keyboard/Kconfig.rtt
```kconfig
# Copyright (c) 2022-2023 XiNGRZ
# SPDX-License-Identifier: MIT

config ZMK_RTT_LOGGING
	bool "Enable RTT logging to help debug"
	select LOG
	select USE_SEGGER_RTT
	select CONSOLE
	select RTT_CONSOLE
```
